## boards/arm/pro_micro_rp2040/Kconfig.board
```kconfig
# Copyright (c) 2022 Sachi King
# SPDX-License-Identifier: MIT

config BOARD_PRO_MICRO_RP2040_DEV_17717
	bool "pro_micro_rp2040_dev_17717"
	depends on SOC_RP2040
```

## boards/arm/pro_micro_rp2040/Kconfig.defconfig
```kconfig
# Copyright (c) 2022 Sachi King
# SPDX-License-Identifier: MIT

if BOARD_PRO_MICRO_RP2040_DEV_17717

config BOARD
	default "pro_micro_rp2040_dev_17717"

config RP2_FLASH_W25Q080
	default y

config ZMK_USB
	default y

if I2C

config I2C_DW
	default y

if I2C_DW

config I2C_DW_CLOCK_SPEED
	default 100

endif # I2C_DW

endif # I2C

endif # BOARD_PRO_MICRO_RP2040_DEV_17717
```
